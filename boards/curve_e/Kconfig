## boards/curve_e/Kconfig.curve_e
```kconfig
# Copyright (c) 2021 The ZMK Contributors
# SPDX-License-Identifier: MIT

config BOARD_CURVE_E
	select SOC_NRF52840_QIAA
	select ZMK_BOARD_COMPAT if BOARD_CURVE_E_NRF52840_ZMK
	imply RETAINED_MEM if BOARD_CURVE_E_NRF52840_ZMK
	imply RETENTION if BOARD_CURVE_E_NRF52840_ZMK
	imply RETENTION_BOOT_MODE if BOARD_CURVE_E_NRF52840_ZMK
```

## boards/curve_e/Kconfig.defconfig
```kconfig
# Copyright (c) 2021 The ZMK Contributors
# SPDX-License-Identifier: MIT

if BOARD_CURVE_E

config ZMK_KEYBOARD_NAME
	default "Curve E"
	
if USB_DEVICE_STACK

config USB_NRFX
	default y

endif # USB_DEVICE_STACK

config ZMK_BLE
	default y

config ZMK_USB
	default y

config ZMK_BATTERY_VOLTAGE_DIVIDER
	default y

endif # BOARD_CURVE_E
```

## boards/curve_e/board.yml
```yaml
board:
  name: curve_e
  vendor: dekb
  socs:
    - name: nrf52840
      variants:
        - name: zmk
```

## experimental/esb/Kconfig
```kconfig
menuconfig CURVE_ESB
    bool "Experimental Curve E ESB transport"
    depends on SOC_NRF52840 && !ZMK_BLE
    select ZMK_ESB
    select MBEDTLS
    select MBEDTLS_CIPHER_AES_ENABLED
    select MBEDTLS_CIPHER_CCM_ENABLED
    select MBEDTLS_SHA256
    select MBEDTLS_MD
    select ENTROPY_GENERATOR
    select CSPRNG_ENABLED

if CURVE_ESB
config CURVE_ESB_RECEIVER
    bool "USB receiver role"
    depends on ZMK_USB && !ZMK_BLE

config ZMK_ESB
    bool
    select NRFX_PPI
    select DYNAMIC_INTERRUPTS

config ZMK_ESB_MAX_PAYLOAD_LENGTH
    int
    default 32
config ZMK_ESB_TX_FIFO_SIZE
    int
    default 8
config ZMK_ESB_RX_FIFO_SIZE
    int
    default 8
config ZMK_ESB_PIPE_COUNT
    int
    default 8
config ZMK_ESB_DEFAULT_RF_CHANNEL
    int
    default 76
config ZMK_ESB_LOG_LEVEL
    int
    default 2
endif
```

## experimental/esb/boards/shields/curve_esb_receiver/Kconfig.shield
```kconfig
config SHIELD_CURVE_ESB_RECEIVER
    def_bool $(shields_list_contains,curve_esb_receiver)
```
